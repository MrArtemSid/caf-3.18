&i2c_2  {
	aw87319@58{ /*AW87319 PA*/
		compatible = "awinic,aw87319_pa";
		reg = <0x58>;
		qcom,ext_pa_spk_aw87319_rst = <&tlmm 124 0>;
	};
};

&i2c_3 {
	focaltech@38 {
		compatible = "focaltech,5x06"; //Our tp is FT5336
		reg = <0x38>;
		interrupt-parent = <&tlmm>;
		interrupts = <65 0x2008>;
		vdd-supply = <&pm8937_l10>;
		vcc_i2c-supply = <&pm8937_l5>;

		pinctrl-names = "pmx_ts_active","pmx_ts_suspend",
				"pmx_ts_release";
		pinctrl-0 = <&ts_int_active &ts_reset_active>;
		pinctrl-1 = <&ts_int_suspend &ts_reset_suspend>;
		pinctrl-2 = <&ts_release>;
		focaltech,name = "ft5336";
		focaltech,family-id = <0x36>;
		focaltech,reset-gpio = <&tlmm 64 0x00>;
		focaltech,irq-gpio = <&tlmm 65 0x2008>;
		focaltech,display-coords = <0 0 720 1280>;
		focaltech,panel-coords = <0 0 720 1280>;
		focaltech,button-map= <139 172 158>; /* APP_SWITCH HOME BACK just like stock rom */
		focaltech,button-y-coord = <2040>;
		focaltech,button-x-coords = <120 500 900>;
		focaltech,no-force-update;
		focaltech,i2c-pull-up;
		focaltech,group-id = <1>;
		focaltech,hard-reset-delay-ms = <20>;
		focaltech,soft-reset-delay-ms = <200>;
		focaltech,num-max-touches = <10>;
		focaltech,fw-delay-aa-ms = <30>;
		focaltech,fw-delay-55-ms = <30>;
		focaltech,fw-upgrade-id1 = <0x79>;
		focaltech,fw-upgrade-id2 = <0x18>;
		focaltech,fw-delay-readid-ms = <10>;
		focaltech,fw-delay-era-flsh-ms = <2000>;
		focaltech,fw-auto-cal;
		focaltech,ignore-id-check;
		focaltech,resume-in-workqueue;
	};
};
